## Kconfig
```kconfig
#
# Copyright (c) 2022 Circuit Dojo LLC
#
# SPDX-License-Identifier: Apache-2.0
#

mainmenu "Application"

rsource "src/version/Kconfig"

source "Kconfig.zephyr"
```

## boards/circuitdojo_feather_nrf9160_ns.conf
```kconfig
# Enable LIS2DH for board specific power savings
CONFIG_LIS2DH=y

# SPI Flash
CONFIG_SPI=y
CONFIG_SPI_NOR=y
CONFIG_SPI_NOR_FLASH_LAYOUT_PAGE_SIZE=4096

# External flash partition defintion
CONFIG_PM_EXTERNAL_FLASH=y
CONFIG_PM_EXTERNAL_FLASH_DEV_NAME="W25Q32JV"
CONFIG_PM_EXTERNAL_FLASH_BASE=0x0
CONFIG_PM_EXTERNAL_FLASH_SIZE=0x400000
```

## src/version/Kconfig
```kconfig
#
# Copyright (c) 2022 Circuit Dojo LLC
#
# SPDX-License-Identifier: Apache-2.0
#

menu "Version"

config APP_VERSION
	string "String of application version"
	default "unknown"

config APP_VERSION_MAJOR
	int "Major version number extracted from Git"
	default 0

config APP_VERSION_MINOR
	int "Minor version number extracted from Git"
	default 0

config APP_VERSION_PATCH
	int "Patch version number extracted from Git"
	default 0

config APP_VERSION_COMMIT
	int "Commit count extracted from Git"
	default 0

config APP_VERSION_HASH
	string "Patch version number extracted from Git"
	default ""

config APP_RELEASE_TYPE
	string "Release type"
	default "debug"

endmenu
```

## west.yml
```yaml
#
# Copyright (c) 2022 Circuit Dojo LLC
#
# SPDX-License-Identifier: Apache-2.0
#

manifest:
  remotes:
    - name: nrfconnect
      url-base: https://github.com/nrfconnect
  projects:
    - name: nrf
      repo-path: sdk-nrf
      remote: nrfconnect
      revision: v1.7.0
      import: true
  self:
    # This repository should be cloned to 
    path: app
```
